//oled
#include <SPI.h>
#include <Wire.h>
#include <Adafruit_GFX.h>
#include <Adafruit_SH1106.h>
#define SCREEN_WIDTH 128  // OLED display width, in pixels
#define SCREEN_HEIGHT 64  // OLED display height, in pixels
#define OLED_RESET 4
Adafruit_SH1106 display(OLED_RESET);
inline void DisplayStuff(uint16_t counter);
inline void Display(uint16_t counter);
// Rotary Encoder Inputs
#include <EEPROM.h>
#include <ClickEncoder.h>
#include <TimerOne.h>
ClickEncoder *encoder;
#define SW 2
int16_t last, value;
//motor
#define enA 5
//int ledPin = 13;
byte n = 1;
byte u = 0;
int getu = 0;
int go;
int addr = 0;
int counter = 0;
int currentStateCLK;
int lastStateCLK;
String currentDir = "";
unsigned long lastButtonPress = 0;
//stepper

static const unsigned char PROGMEM image_data_mmulogo[] = {
  0x00, 0x00, 0x00, 0x00, 0x00, 0x00, 0x00, 0x00, 0x00, 0x00, 0x00, 0x00, 0x00, 0x00, 0x00, 0x00,
  0x00, 0x00, 0x00, 0x00, 0x00, 0x00, 0x00, 0x01, 0x80, 0x00, 0x00, 0x00, 0x00, 0x00, 0x00, 0x00,
  0x00, 0x00, 0x00, 0x00, 0x00, 0x00, 0x00, 0x07, 0xC0, 0x00, 0x00, 0x00, 0x00, 0x00, 0x00, 0x00,
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  0x00, 0x00, 0x00, 0x00, 0x00, 0x00, 0x00, 0x00, 0x00, 0x00, 0x00, 0x00, 0x00, 0x00, 0x00, 0x00
};

void timerIsr() {
  encoder->service();
}

void ngat() {

  int btnState = digitalRead(SW);

  //If we detect LOW signal, button is pressed
  if (btnState == LOW) {
    //if 50ms have passed since last LOW pulse, it means that the
    //button has been pressed, released and pressed again
    if (millis() - lastButtonPress > 50) {
      // Serial.println("Button pressed!");

      if (n == 0) {
        n = 1;
        u = 0;
      } else {
        n = 0;
      }
      //Display(counter);

      //encoder();
    }

    // Remember last button press event
    lastButtonPress = millis();
  }
}

void encoder_rorate() {

  while (n == 1) {
    digitalWrite(5, HIGH);
    if (u == 0) {
      DisplayStuff(counter);
    }
    u = 1;
    counter += encoder->getValue();
    if (counter <= 400) {
      counter = 400;
    }
    if (counter >= 2500) {
      counter = 2500;
    }
    if (counter != last) {
      last = counter;
      Serial.print("Encoder counter: ");
      Serial.println(counter);
    }
    DisplayStuff(counter);
    int val = counter / 12;
    EEPROM.update(0, val);
    addr = addr + 1;
    if (addr == EEPROM.length())
      addr = 0;
    delay(5);  // delay 5ms để trước khi lưu giá trị tiếp theo
  }
  return counter;
}

void setup() {
  // Setup Serial Monitor
  Serial.begin(9600);
  //setup encoder
  encoder = new ClickEncoder(A1, A0, 2);
  Timer1.initialize(1000);
  Timer1.attachInterrupt(timerIsr);
  last = -1;
  //oled
  display.begin(SH1106_SWITCHCAPVCC, 0x3C);
  display.clearDisplay();                                    //clear display buffer
  display.drawBitmap(0, 0, image_data_mmulogo, 128, 64, 1);  //draw boot screen
  display.setTextSize(1.5);                                  //text size small
  display.setTextColor(WHITE);                               //white text - might not be needed
  display.setCursor(30, 50);                                 //from 35X 10Y
  display.println("opensens.io");                            //print text
  display.display();                                         //display boot screen
  delay(2000);
  //delay(20000);
  //stepper
  pinMode(11, OUTPUT);
  digitalWrite(11, LOW);
  digitalWrite(5, HIGH);

  // Set encoder pins as inputs
  pinMode(SW, INPUT_PULLUP);
  pinMode(2, INPUT_PULLUP);
  //pinMode(ledPin, OUTPUT);
  attachInterrupt(0, ngat, LOW);
  getu = EEPROM.read(addr);
  delay(5);
  counter = getu * 12;  // Read the current state of CLK
  //counter = 1;
  DisplayStuff(counter);
}

void loop() {

  encoder_rorate();
  if (u == 1) {
    Display(counter);
    u = 0;
  }
  go = counter * 0.1;
  int pwmOutput = map(go, 1023, 0, 0, 1023);  // Map the potentiometer value from 0 to 255
  analogWrite(enA, pwmOutput);                     // Send PWM signal to L298N Enable pin
}



inline void DisplayStuff(uint16_t counter) {
  display.clearDisplay();       //clear display buffer
  display.setTextSize(2);       //text size small
  display.setTextColor(WHITE);  //white text - might not be needed
  display.setCursor(22, 15);    //from 35X 10Y
  display.println("SETTING");   //print text
  display.setTextSize(3);       //text size medium
  display.setCursor(30, 40);    //from 15X 30Y
  display.print(counter);       //print rpm value
  display.setTextSize(1);       //text size small
  display.println(" RPM");      //print text after previous, same line
  display.display();            //display buffer
}
inline void Display(uint16_t counter) {
  display.clearDisplay();         //clear display buffer
  display.setTextSize(2);         //text size small
  display.setTextColor(WHITE);    //white text - might not be needed
  display.setCursor(5, 10);       //from 35X 10Y
  display.println("RDE SYSTEM");  //print text
  display.setTextSize(3);         //text size medium
  display.setCursor(30, 40);      //from 15X 30Y
  display.print(counter);         //print rpm value
  display.setTextSize(1);         //text size small
  display.println(" RPM");        //print text after previous, same line
  display.display();              //display buffer
}